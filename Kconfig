## Kconfig
```kconfig
menu "ESP TinyUSB Audio"
    config ESP_TINYUSB_DEBUG_LEVEL
        int "TinyUSB log level (0-3)"
        default 0
        range 0 3
        help
            Specify verbosity of TinyUSB log output.

    menu "TinyUSB task configuration"
        config ESP_TINYUSB_TASK_PRIORITY
            int "TinyUSB task priority"
            default 5
            help
                Set the priority of the default TinyUSB main task.

        config ESP_TINYUSB_TASK_STACK_SIZE
            int "TinyUSB task stack size (bytes)"
            default 4096
            help
                Set the stack size of the default TinyUSB main task.
    endmenu

    menu "Descriptor configuration"
        config ESP_TINYUSB_DESC_CUSTOM_VID
            hex "VID: Custom vendor ID"
            default 0xcafe
            help
                Custom Vendor ID.

        config ESP_TINYUSB_DESC_CUSTOM_PID
            hex "PID: Custom product ID"
            default 0x4011
            help
                Custom Product ID.

        config ESP_TINYUSB_DESC_BCD_DEVICE
            hex "bcdDevice"
            default 0x0100
            help
                Version of the firmware of the USB device.

        config ESP_TINYUSB_DESC_MANUFACTURER_STRING
            string "Manufacturer name"
            default "Espressif Systems"
            help
                Name of the manufacturer of the USB device.

        config ESP_TINYUSB_DESC_PRODUCT_STRING
            string "Product name"
            default "Espressif Device"
            help
                Name of the USB device.

        config ESP_TINYUSB_DESC_SERIAL_STRING
            string "Serial string"
            default "123456"
            help
                Serial number of the USB device.

        config ESP_TINYUSB_DESC_CDC_STRING
            depends on ESP_TINYUSB_CDC_ENABLED
            string "CDC Device String"
            default "Espressif CDC Device"
            help
                Name of the CDC device.

        config ESP_TINYUSB_DESC_AUDIO_STRING
            depends on ESP_TINYUSB_AUDIO_ENABLED
            string "Audio Device String"
            default "Espressif Audio (UAC2) Device"
            help
                Name of the UAC2 device.

    endmenu # "Descriptor configuration"

    menu "Audio Device Class (UAC2)"
        config ESP_TINYUSB_AUDIO_ENABLED
            bool "Enable TinyUSB Audio feature"
            default n
            help
                Enable TinyUSB Audio feature.

        config ESP_TINYUSB_AUDIO_SAMPLE_RATE
            depends on ESP_TINYUSB_AUDIO_ENABLED
            int "Audio sample rate (Hz)"
            default 48000
            range 8000 48000
            help
                Audio sample rate.

        choice ESP_TINYUSB_AUDIO_BIT_DEPTH
            prompt "Audio bit depth"
            depends on ESP_TINYUSB_AUDIO_ENABLED
            default ESP_AUDIO_16_BIT
            help
                Audio bit depth

            config ESP_AUDIO_16_BIT
                bool "16bit"
                help
                    Default. 16bit audio

            config ESP_AUDIO_24_BIT
                bool "24bit"
                help
                    24bit audio
        endchoice

        choice ESP_TINYUSB_AUDIO_CHANNELS
            prompt "Audio channels"
            depends on ESP_TINYUSB_AUDIO_ENABLED
            default ESP_AUDIO_1_CH
            help
                Number of audio channels.

            config ESP_AUDIO_1_CH
                bool "1"
                help
                    1 audio channels.

            config ESP_AUDIO_2_CH
                bool "2"
                help
                    2 audio channels

            config ESP_AUDIO_4_CH
                bool "4"
                help
                    4 audio channels
        endchoice

        config AUDIO_BYTES_PER_SAMPLE
            int
            default 2 if ESP_AUDIO_16_BIT
            default 3 if ESP_AUDIO_24_BIT

        config AUDIO_CHANNELS
            int
            default 1 if ESP_AUDIO_1_CH
            default 2 if ESP_AUDIO_2_CH
            default 3 if ESP_AUDIO_4_CH

    endmenu

    menu "Communication Device Class (CDC)"
        config ESP_TINYUSB_CDC_ENABLED
            bool "Enable TinyUSB CDC feature"
            default n
            help
                Enable TinyUSB CDC feature.

        config ESP_TINYUSB_CDC_RX_BUFSIZE
            depends on ESP_TINYUSB_CDC_ENABLED
            int "CDC FIFO size of RX channel"
            default 64
            range 64 10000
            help
                CDC FIFO size of RX channel.

        config ESP_TINYUSB_CDC_TX_BUFSIZE
            depends on ESP_TINYUSB_CDC_ENABLED
            int "CDC FIFO size of TX channel"
            default 64
            help
                CDC FIFO size of TX channel.
    endmenu # "Communication Device Class"
endmenu # "TinyUSB Stack"
```
